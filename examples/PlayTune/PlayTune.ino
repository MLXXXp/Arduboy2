/***************************************************************
Play a musical composition in the background while
the main sketch code runs in the foreground.

The ArduboyPlaytune library must be installed to use this sketch
https://github.com/Arduboy/ArduboyPlayTune

The D-Pad buttons will move the text and play a tone.

The A button mutes the sound.
The screen is inverted when sound is muted.

The B button will turn sound back on if it's muted.

The score that is played contains two parts.
With the DevKit only one part is played.
***************************************************************/

#include <Arduboy2.h>
#include <ArduboyPlaytune.h>

// 2 Part Inventions No. 3 - J.S. Bach
const byte score[] PROGMEM = {
 2,154, 0x90,62, 0,166, 0x90,64, 0,166, 0x90,66, 0,166, 0x90,64, 0,166,
 0x90,67, 0,166, 0x90,66, 0,166, 0x90,64, 0,166, 0x90,62, 0,166, 0x90,69,
 0,166, 0x90,67, 0,166, 0x90,66, 0,166, 0x90,64, 0,166, 0x91,50, 0x90,66,
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 1,244, 0x90,62, 0,138, 0x80, 0,27, 0x90,62, 0x91,38, 7,208, 0x80, 0x81,
 0xf0
};

Arduboy2 arduboy;
ArduboyPlaytune tunes(arduboy.audio.enabled);

void setup()
{
  arduboy.begin();

  arduboy.setFrameRate(25);
  arduboy.setTextSize(3);

  // audio setup
  tunes.initChannel(PIN_SPEAKER_1);
#ifndef AB_DEVKIT
  // if not a DevKit
  tunes.initChannel(PIN_SPEAKER_2);
#else
  // if it's a DevKit
  tunes.initChannel(PIN_SPEAKER_1); // use the same pin for both channels
  tunes.toneMutesScore(true);       // mute the score when a tone is sounding
#endif

  arduboy.invert(!arduboy.audio.enabled()); // invert display if sound muted
}


int x = 20, y = 10; // initial text position

void loop()
{
  // pause render until it's time for the next frame
  if (!(arduboy.nextFrame()))
    return;

  if (arduboy.pressed(UP_BUTTON)) {
    y-=1;
    tunes.tone(1175,300);
  } else if (arduboy.pressed(DOWN_BUTTON)) {
    y+=1;
    tunes.tone(1397,300);
  } else if (arduboy.pressed(LEFT_BUTTON)) {
    x-=1;
    tunes.tone(1047,300);
  } else if (arduboy.pressed(RIGHT_BUTTON)) {
    x+=1;
    tunes.tone(1319,300);
  }

  if (arduboy.pressed(A_BUTTON)) {
    arduboy.invert(true);
    arduboy.audio.off();
  } else if (arduboy.pressed(B_BUTTON)) {
    arduboy.invert(false);
    arduboy.audio.on();
  }

  arduboy.clear();
  arduboy.setCursor(x,y);
  arduboy.print("Music");
  arduboy.setCursor(x+8,y+24);
  arduboy.print("Demo");
  arduboy.display();

  // play the tune if we aren't already
  if (!tunes.playing())
    tunes.playScore(score);
}
